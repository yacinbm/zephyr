## drivers/serial/Kconfig.silabs_vcom
```kconfig
# Copyright (c) 2025, Yacin Belmihoub-Martel
# SPDX-License-Identifier: Apache-2.0

config UART_SILABS_VCOM
	bool "Silabs VCOM auto config"
	default y
	select GPIO
	depends on DT_HAS_SILABS_VCOM_UART_ENABLED
	help
	  Enable Virtual COM port configuration over ITM.
```

## dts/bindings/serial/silabs,vcom-uart.yaml
```yaml
description: Silabs VCOM UART

compatible: "silabs,vcom-uart"

include: uart-device.yaml

properties:
  en-gpios:
    type: phandle-array
    required: true
    description: Pin used to enable VCOM adapter.
```
